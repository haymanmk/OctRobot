## CMakeLists.txt
```
# SPDX-License-Identifier: Apache-2.0

cmake_minimum_required(VERSION 3.20.0)

find_package(Zephyr REQUIRED HINTS $ENV{ZEPHYR_BASE})

project(test_kinematics LANGUAGES C)

# Path to the main application source
set(APP_SRC_DIR ${CMAKE_CURRENT_SOURCE_DIR}/../../app)

# Include application headers + generated test-vector header
target_include_directories(app PRIVATE
  ${APP_SRC_DIR}/include
  ${CMAKE_CURRENT_SOURCE_DIR}/include
)

# Application kinematics sources under test
target_sources(app PRIVATE
  ${APP_SRC_DIR}/src/kinematics/kinematics_math.c
  ${APP_SRC_DIR}/src/kinematics/matrix_exp.c
  ${APP_SRC_DIR}/src/kinematics/robot_geometry.c
  ${APP_SRC_DIR}/src/kinematics/forward_kinematics_poe.c
  ${APP_SRC_DIR}/src/kinematics/inverse_kinematics_poe.c
  ${APP_SRC_DIR}/src/controller/joint_map.c
  ${APP_SRC_DIR}/src/controller/cartesian_pose.c
)

# HAL flash stub (replaces real NVS-based hal_flash.c for test builds)
target_sources(app PRIVATE
  src/hal_flash_stub.c
)

# Test sources
target_sources(app PRIVATE
  src/test_kinematics_math.c
  src/test_matrix_exp.c
  src/test_forward_kinematics.c
  src/test_fk_ground_truth.c
  src/test_inverse_kinematics.c
  src/test_ik_ground_truth.c
  src/test_rpy.c
  src/test_joint_map.c
  src/test_cartesian_pose.c
)
```

## prj.conf
```kconfig
# Ztest configuration for kinematics unit tests
CONFIG_ZTEST=y

# Stack sizes for test framework
CONFIG_MAIN_STACK_SIZE=4096
CONFIG_ZTEST_STACK_SIZE=4096

# CRC (used by robot_geometry under test)
CONFIG_CRC=y

# C standard
CONFIG_STD_C17=y
```

## include/fk_test_vectors.h
```c
/* Auto-generated by validation/gen_test_vectors.py — do not edit */
/* Robot: mecharm_270_pi  |  Generated: 2026-05-29 */
#ifndef FK_TEST_VECTORS_H
#define FK_TEST_VECTORS_H

#include <stddef.h>

#define NUM_FK_TEST_VECTORS 35

typedef struct {
    float theta[6];
    float T_expected[4][4];
    const char *description;
} fk_test_vector_t;

static const fk_test_vector_t FK_TEST_VECTORS[NUM_FK_TEST_VECTORS] = {
    /* [0] zero_config */
    {
        .theta = {0.00000000f, 0.00000000f, 0.00000000f, 0.00000000f, 0.00000000f, 0.00000000f},
        .T_expected = {
        {0.00000000f, 0.00000000f, 1.00000000f, 0.16800000f},
        {-1.00000000f, 0.00000000f, 0.00000000f, 0.00000000f},
        {0.00000000f, -1.00000000f, 0.00000000f, 0.24300000f},
        {0.00000000f, 0.00000000f, 0.00000000f, 1.00000000f}
    },
        .description = "zero_config"
    },
    /* [1] j0_pos30 */
    {
        .theta = {0.52359878f, 0.00000000f, 0.00000000f, 0.00000000f, 0.00000000f, 0.00000000f},
        .T_expected = {
        {0.50000000f, 0.00000000f, 0.86602540f, 0.14549227f},
        {-0.86602540f, 0.00000000f, 0.50000000f, 0.08400000f},
        {0.00000000f, -1.00000000f, 0.00000000f, 0.24300000f},
        {0.00000000f, 0.00000000f, 0.00000000f, 1.00000000f}
    },
        .description = "j0_pos30"
    },
    /* [2] j0_neg30 */
    {
        .theta = {-0.52359878f, 0.00000000f, 0.00000000f, 0.00000000f, 0.00000000f, 0.00000000f},
        .T_expected = {
        {-0.50000000f, 0.00000000f, 0.86602540f, 0.14549227f},
        {-0.86602540f, 0.00000000f, -0.50000000f, -0.08400000f},
        {0.00000000f, -1.00000000f, 0.00000000f, 0.24300000f},
        {0.00000000f, 0.00000000f, 0.00000000f, 1.00000000f}
    },
        .description = "j0_neg30"
    },
    /* [3] j1_pos30 */
    {
        .theta = {0.00000000f, 0.52359878f, 0.00000000f, 0.00000000f, 0.00000000f, 0.00000000f},
        .T_expected = {
        {0.00000000f, -0.50000000f, 0.86602540f, 0.19799227f},
        {-1.00000000f, 0.00000000f, 0.00000000f, 0.00000000f},
        {0.00000000f, -0.86602540f, -0.50000000f, 0.14493267f},
        {0.00000000f, 0.00000000f, 0.00000000f, 1.00000000f}
    },
        .description = "j1_pos30"
    },
    /* [4] j1_neg30 */
    {
        .theta = {0.00000000f, -0.52359878f, 0.00000000f, 0.00000000f, 0.00000000f, 0.00000000f},
        .T_expected = {
        {0.00000000f, 0.50000000f, 0.86602540f, 0.09299227f},
        {-1.00000000f, 0.00000000f, 0.00000000f, 0.00000000f},
        {0.00000000f, -0.86602540f, 0.50000000f, 0.31293267f},
        {0.00000000f, 0.00000000f, 0.00000000f, 1.00000000f}
    },
        .description = "j1_neg30"
    },
    /* [5] j2_pos30 */
    {
        .theta = {0.00000000f, 0.00000000f, 0.52359878f, 0.00000000f, 0.00000000f, 0.00000000f},
        .T_expected = {
        {0.00000000f, -0.50000000f, 0.86602540f, 0.14799227f},
        {-1.00000000f, 0.00000000f, 0.00000000f, 0.00000000f},
        {0.00000000f, -0.86602540f, -0.50000000f, 0.15833013f},
        {0.00000000f, 0.00000000f, 0.00000000f, 1.00000000f}
    },
        .description = "j2_pos30"
    },
    /* [6] j2_neg30 */
    {
        .theta = {0.00000000f, 0.00000000f, -0.52359878f, 0.00000000f, 0.00000000f, 0.00000000f},
        .T_expected = {
        {0.00000000f, 0.50000000f, 0.86602540f, 0.14299227f},
        {-1.00000000f, 0.00000000f, 0.00000000f, 0.00000000f},
        {0.00000000f, -0.86602540f, 0.50000000f, 0.32633013f},
        {0.00000000f, 0.00000000f, 0.00000000f, 1.00000000f}
    },
        .description = "j2_neg30"
    },
    /* [7] j3_pos30 */
    {
        .theta = {0.00000000f, 0.00000000f, 0.00000000f, 0.52359878f, 0.00000000f, 0.00000000f},
        .T_expected = {
        {0.00000000f, 0.00000000f, 1.00000000f, 0.16800000f},
        {-0.86602540f, 0.50000000f, 0.00000000f, -0.00013397f},
        {-0.50000000f, -0.86602540f, 0.00000000f, 0.24350000f},
        {0.00000000f, 0.00000000f, 0.00000000f, 1.00000000f}
    },
        .description = "j3_pos30"
    },
    /* [8] j3_neg30 */
    {
        .theta = {0.00000000f, 0.00000000f, 0.00000000f, -0.52359878f, 0.00000000f, 0.00000000f},
        .T_expected = {
        {0.00000000f, 0.00000000f, 1.00000000f, 0.16800000f},
        {-0.86602540f, -0.50000000f, 0.00000000f, -0.00013397f},
        {0.50000000f, -0.86602540f, 0.00000000f, 0.24250000f},
        {0.00000000f, 0.00000000f, 0.00000000f, 1.00000000f}
    },
        .description = "j3_neg30"
    },
    /* [9] j4_pos30 */
    {
        .theta = {0.00000000f, 0.00000000f, 0.00000000f, 0.00000000f, 0.52359878f, 0.00000000f},
        .T_expected = {
        {0.00000000f, -0.50000000f, 0.86602540f, 0.15996152f},
        {-1.00000000f, 0.00000000f, 0.00000000f, 0.00000000f},
        {0.00000000f, -0.86602540f, -0.50000000f, 0.21300000f},
        {0.00000000f, 0.00000000f, 0.00000000f, 1.00000000f}
    },
        .description = "j4_pos30"
    },
    /* [10] j4_neg30 */
    {
        .theta = {0.00000000f, 0.00000000f, 0.00000000f, 0.00000000f, -0.52359878f, 0.00000000f},
        .T_expected = {
        {0.00000000f, 0.50000000f, 0.86602540f, 0.15996152f},
        {-1.00000000f, 0.00000000f, 0.00000000f, 0.00000000f},
        {0.00000000f, -0.86602540f, 0.50000000f, 0.27300000f},
        {0.00000000f, 0.00000000f, 0.00000000f, 1.00000000f}
    },
        .description = "j4_neg30"
    },
    /* [11] j5_pos30 */
    {
        .theta = {0.00000000f, 0.00000000f, 0.00000000f, 0.00000000f, 0.00000000f, 0.52359878f},
        .T_expected = {
        {0.00000000f, 0.00000000f, 1.00000000f, 0.16800000f},
        {-0.86602540f, 0.50000000f, 0.00000000f, 0.00000000f},
        {-0.50000000f, -0.86602540f, 0.00000000f, 0.24300000f},
        {0.00000000f, 0.00000000f, 0.00000000f, 1.00000000f}
    },
        .description = "j5_pos30"
    },
    /* [12] j5_neg30 */
    {
        .theta = {0.00000000f, 0.00000000f, 0.00000000f, 0.00000000f, 0.00000000f, -0.52359878f},
        .T_expected = {
        {0.00000000f, 0.00000000f, 1.00000000f, 0.16800000f},
        {-0.86602540f, -0.50000000f, 0.00000000f, 0.00000000f},
        {0.50000000f, -0.86602540f, 0.00000000f, 0.24300000f},
        {0.00000000f, 0.00000000f, 0.00000000f, 1.00000000f}
    },
        .description = "j5_neg30"
    },
    /* [13] j0_pos90 */
    {
        .theta = {1.57079633f, 0.00000000f, 0.00000000f, 0.00000000f, 0.00000000f, 0.00000000f},
        .T_expected = {
        {1.00000000f, 0.00000000f, 0.00000000f, 0.00000000f},
        {-0.00000000f, 0.00000000f, 1.00000000f, 0.16800000f},
        {0.00000000f, -1.00000000f, 0.00000000f, 0.24300000f},
        {0.00000000f, 0.00000000f, 0.00000000f, 1.00000000f}
    },
        .description = "j0_pos90"
    },
    /* [14] j0_neg90 */
    {
        .theta = {-1.57079633f, 0.00000000f, 0.00000000f, 0.00000000f, 0.00000000f, 0.00000000f},
        .T_expected = {
        {-1.00000000f, 0.00000000f, 0.00000000f, 0.00000000f},
        {-0.00000000f, 0.00000000f, -1.00000000f, -0.16800000f},
        {0.00000000f, -1.00000000f, 0.00000000f, 0.24300000f},
        {0.00000000f, 0.00000000f, 0.00000000f, 1.00000000f}
    },
        .description = "j0_neg90"
    },
    /* [15] j0_pos180 */
    {
        .theta = {3.14159265f, 0.00000000f, 0.00000000f, 0.00000000f, 0.00000000f, 0.00000000f},
        .T_expected = {
        {0.00000000f, 0.00000000f, -1.00000000f, -0.16800000f},
        {1.00000000f, 0.00000000f, 0.00000000f, 0.00000000f},
        {0.00000000f, -1.00000000f, 0.00000000f, 0.24300000f},
        {0.00000000f, 0.00000000f, 0.00000000f, 1.00000000f}
    },
        .description = "j0_pos180"
    },
    /* [16] j0j1_30_neg20 */
    {
        .theta = {0.52359878f, -0.34906585f, 0.00000000f, 0.00000000f, 0.00000000f, 0.00000000f},
        .T_expected = {
        {0.50000000f, 0.29619813f, 0.81379768f, 0.10561721f},
        {-0.86602540f, 0.17101007f, 0.46984631f, 0.06097812f},
        {0.00000000f, -0.93969262f, 0.34202014f, 0.29412711f},
        {0.00000000f, 0.00000000f, 0.00000000f, 1.00000000f}
    },
        .description = "j0j1_30_neg20"
    },
    /* [17] j1j2_30_neg20 */
    {
        .theta = {0.00000000f, 0.52359878f, -0.34906585f, 0.00000000f, 0.00000000f, 0.00000000f},
        .T_expected = {
        {0.00000000f, -0.17364818f, 0.98480775f, 0.21631594f},
        {-1.00000000f, 0.00000000f, 0.00000000f, 0.00000000f},
        {0.00000000f, -0.98480775f, -0.17364818f, 0.20035369f},
        {0.00000000f, 0.00000000f, 0.00000000f, 1.00000000f}
    },
        .description = "j1j2_30_neg20"
    },
    /* [18] j2j3_30_neg20 */
    {
        .theta = {0.00000000f, 0.00000000f, 0.52359878f, -0.34906585f, 0.00000000f, 0.00000000f},
        .T_expected = {
        {0.17101007f, -0.46984631f, 0.86602540f, 0.14782126f},
        {-0.93969262f, -0.34202014f, 0.00000000f, -0.00006031f},
        {0.29619813f, -0.81379768f, -0.50000000f, 0.15803393f},
        {0.00000000f, 0.00000000f, 0.00000000f, 1.00000000f}
    },
        .description = "j2j3_30_neg20"
    },
    /* [19] j3j4_30_neg20 */
    {
        .theta = {0.00000000f, 0.00000000f, 0.00000000f, 0.52359878f, -0.34906585f, 0.00000000f},
        .T_expected = {
        {0.00000000f, 0.34202014f, 0.93969262f, 0.16438156f},
        {-0.86602540f, 0.46984631f, -0.17101007f, -0.01039458f},
        {-0.50000000f, -0.81379768f, 0.29619813f, 0.26127189f},
        {0.00000000f, 0.00000000f, 0.00000000f, 1.00000000f}
    },
        .description = "j3j4_30_neg20"
    },
    /* [20] j4j5_30_neg20 */
    {
        .theta = {0.00000000f, 0.00000000f, 0.00000000f, 0.00000000f, 0.52359878f, -0.34906585f},
        .T_expected = {
        {0.17101007f, -0.46984631f, 0.86602540f, 0.15996152f},
        {-0.93969262f, -0.34202014f, 0.00000000f, -0.00000000f},
        {0.29619813f, -0.81379768f, -0.50000000f, 0.21300000f},
        {0.00000000f, 0.00000000f, 0.00000000f, 1.00000000f}
    },
        .description = "j4j5_30_neg20"
    },
    /* [21] all_joints_mixed */
    {
        .theta = {0.17453293f, -0.34906585f, 0.52359878f, -0.69813170f, 0.87266463f, -1.04719755f},
        .T_expected = {
        {0.77567188f, -0.16730521f, 0.60855740f, 0.10836019f},
        {0.11118172f, -0.91292351f, -0.39269491f, -0.01113074f},
        {0.62126626f, 0.37226286f, -0.68952781f, 0.17613461f},
        {0.00000000f, 0.00000000f, 0.00000000f, 1.00000000f}
    },
        .description = "all_joints_mixed"
    },
    /* [22] all_joints_30deg */
    {
        .theta = {0.52359878f, 0.52359878f, 0.52359878f, 0.52359878f, 0.52359878f, 0.52359878f},
        .T_expected = {
        {-0.44751588f, -0.89114564f, -0.07475953f, 0.08977306f},
        {-0.87439882f, 0.41850953f, 0.24551270f, 0.06899631f},
        {-0.18750000f, 0.17524047f, -0.96650635f, 0.07583142f},
        {0.00000000f, 0.00000000f, 0.00000000f, 1.00000000f}
    },
        .description = "all_joints_30deg"
    },
    /* [23] rng_seed0 */
    {
        .theta = {0.43027783f, -0.72323637f, -1.44207421f, -1.51887323f, 0.98416748f, 1.29670989f},
        .T_expected = {
        {0.45327237f, 0.88600489f, 0.09767029f, -0.11188364f},
        {-0.39297235f, 0.29697742f, -0.87027418f, -0.10729904f},
        {-0.80007305f, 0.35608951f, 0.48278709f, 0.32916226f},
        {0.00000000f, 0.00000000f, 0.00000000f, 1.00000000f}
    },
        .description = "rng_seed0"
    },
    /* [24] rng_seed1 */
    {
        .theta = {0.03713873f, 1.41517344f, -1.11790555f, 1.40947381f, -0.59114893f, -0.24087706f},
        .T_expected = {
        {-0.38523348f, 0.38217261f, 0.83996385f, 0.25409678f},
        {-0.36604271f, 0.77226496f, -0.51924904f, -0.02442630f},
        {-0.84711741f, -0.50749476f, -0.15761081f, 0.11813315f},
        {0.00000000f, 0.00000000f, 0.00000000f, 1.00000000f}
    },
        .description = "rng_seed1"
    },
    /* [25] rng_seed2 */
    {
        .theta = {-0.74891757f, -0.63305874f, 0.98716928f, -1.28203388f, 0.31447508f, 0.71804407f},
        .T_expected = {
        {-0.55605082f, -0.71184900f, 0.42904369f, 0.05714491f},
        {-0.59475603f, -0.01979597f, -0.80366248f, -0.07838711f},
        {0.58057967f, -0.70205350f, -0.41236892f, 0.16022102f},
        {0.00000000f, 0.00000000f, 0.00000000f, 1.00000000f}
    },
        .description = "rng_seed2"
    },
    /* [26] rng_seed3 */
    {
        .theta = {-1.30172153f, -0.82683418f, 0.94648165f, 0.25811965f, -1.27508248f, -0.21008791f},
        .T_expected = {
        {-0.98525367f, 0.11225203f, -0.12913053f, 0.00133216f},
        {-0.04259985f, -0.89187676f, -0.45026780f, -0.06006758f},
        {-0.16571200f, -0.43812706f, 0.88350677f, 0.25105783f},
        {0.00000000f, 0.00000000f, 0.00000000f, 1.00000000f}
    },
        .description = "rng_seed3"
    },
    /* [27] rng_seed4 */
    {
        .theta = {1.39190181f, 0.03558656f, 1.49616373f, -1.31684247f, 0.33726829f, -0.38802884f},
        .T_expected = {
        {0.06489090f, 0.94950818f, 0.30695829f, 0.02125453f},
        {0.99412472f, -0.03480639f, -0.10249174f, 0.00533170f},
        {-0.08663264f, 0.31180560f, -0.94618817f, 0.07340511f},
        {0.00000000f, 0.00000000f, 0.00000000f, 1.00000000f}
    },
        .description = "rng_seed4"
    },
    /* [28] rng_seed5 */
    {
        .theta = {0.95819494f, 0.96742452f, 0.04814667f, -0.67292481f, -1.40136803f, -0.36640747f},
        .T_expected = {
        {0.76690267f, 0.63737844f, -0.07489341f, 0.07790512f},
        {-0.11303652f, 0.24902982f, 0.96187676f, 0.17457729f},
        {0.63173020f, -0.72920016f, 0.26302867f, 0.12105462f},
        {0.00000000f, 0.00000000f, 0.00000000f, 1.00000000f}
    },
        .description = "rng_seed5"
    },
    /* [29] rng_seed6 */
    {
        .theta = {0.11989685f, -0.49237908f, -0.41133740f, -0.39428004f, 1.53135360f, 0.41706613f},
        .T_expected = {
        {-0.40936945f, -0.45690405f, 0.78971852f, 0.06319827f},
        {-0.90573453f, 0.30770896f, -0.29147926f, -0.01566071f},
        {-0.10982541f, -0.83459804f, -0.53980042f, 0.28143707f},
        {0.00000000f, 0.00000000f, 0.00000000f, 1.00000000f}
    },
        .description = "rng_seed6"
    },
    /* [30] rng_seed7 */
    {
        .theta = {0.39299900f, 1.24788396f, 0.86609214f, -0.86328707f, -0.62779613f, 1.17355276f},
        .T_expected = {
        {-0.09617212f, -0.96202081f, -0.25547383f, 0.02419525f},
        {-0.92605408f, -0.00762273f, 0.37731383f, 0.03864502f},
        {-0.36493117f, 0.27286965f, -0.89015021f, 0.02167696f},
        {0.00000000f, 0.00000000f, 0.00000000f, 1.00000000f}
    },
        .description = "rng_seed7"
    },
    /* [31] rng_seed8 */
    {
        .theta = {-0.54358262f, 1.53082535f, -0.56953670f, 0.90650322f, 1.16206416f, -0.34216717f},
        .T_expected = {
        {-0.66662765f, -0.72541304f, 0.17141613f, 0.15258019f},
        {-0.39840306f, 0.54111879f, 0.74058453f, -0.04200345f},
        {-0.62998617f, 0.42540142f, -0.64973153f, 0.01777276f},
        {0.00000000f, 0.00000000f, 0.00000000f, 1.00000000f}
    },
        .description = "rng_seed8"
    },
    /* [32] rng_seed9 */
    {
        .theta = {1.16317218f, -0.66973349f, 0.32404947f, 0.87189904f, 0.67881847f, 1.30495513f},
        .T_expected = {
        {-0.50666579f, -0.85669895f, -0.09673002f, 0.00942135f},
        {-0.14950993f, -0.02318776f, 0.98848829f, 0.09366866f},
        {-0.84907983f, 0.51529530f, -0.11633656f, 0.25143776f},
        {0.00000000f, 0.00000000f, 0.00000000f, 1.00000000f}
    },
        .description = "rng_seed9"
    },
    /* [33] rng_seed10 */
    {
        .theta = {1.43257162f, -0.91834468f, 1.03184004f, -1.10181271f, 0.04022689f, -1.14379230f},
        .T_expected = {
        {-0.60094829f, 0.78055418f, 0.17203580f, 0.01476572f},
        {0.20956233f, -0.05383928f, 0.97631192f, 0.08654381f},
        {0.77132663f, 0.62276521f, -0.13122014f, 0.18269076f},
        {0.00000000f, 0.00000000f, 0.00000000f, 1.00000000f}
    },
        .description = "rng_seed10"
    },
    /* [34] rng_seed11 */
    {
        .theta = {-1.16688112f, -0.00226866f, 0.31886649f, -1.48066715f, -1.10607283f, 1.34526460f},
        .T_expected = {
        {-0.07068791f, -0.05633477f, 0.99590643f, 0.09965514f},
        {-0.99277255f, 0.10104522f, -0.06474971f, -0.09955382f},
        {-0.09698392f, -0.99328559f, -0.06307028f, 0.20439637f},
        {0.00000000f, 0.00000000f, 0.00000000f, 1.00000000f}
    },
        .description = "rng_seed11"
    }
};

#endif /* FK_TEST_VECTORS_H */
```

## include/ik_test_vectors.h
```c
/* Auto-generated by validation/gen_test_vectors.py — do not edit */
/* Robot: mecharm_270_pi  |  Generated: 2026-05-29 */
#ifndef IK_TEST_VECTORS_H
#define IK_TEST_VECTORS_H

#include <stddef.h>

#define NUM_IK_TEST_VECTORS 13

typedef struct {
    float seed[6];
    float T_target[4][4];
    float theta_ref[6];
    int converged;
    const char *description;
} ik_test_vector_t;

static const ik_test_vector_t IK_TEST_VECTORS[NUM_IK_TEST_VECTORS] = {
    /* [0] ik_home */
    {
        .seed = {0.06699633f, 0.01931081f, -0.04222735f, -0.09140969f, 0.09473088f, 0.01929434f},
        .T_target = {
        {0.00000000f, 0.00000000f, 1.00000000f, 0.16800000f},
        {-1.00000000f, 0.00000000f, 0.00000000f, 0.00000000f},
        {0.00000000f, -1.00000000f, 0.00000000f, 0.24300000f},
        {0.00000000f, 0.00000000f, 0.00000000f, 1.00000000f}
    },
        .theta_ref = {0.00000522f, 0.00002038f, -0.00044529f, -0.04585256f, 0.00042476f, 0.04585252f},
        .converged = 1,
        .description = "ik_home"
    },
    /* [1] ik_rng_seed0 */
    {
        .seed = {0.31291280f, 0.31816175f, -1.07241286f, -0.70074994f, 0.12543393f, 0.05546908f},
        .T_target = {
        {-0.06459478f, 0.51958908f, 0.85197107f, 0.16325653f},
        {-0.90439167f, -0.39133597f, 0.17009371f, 0.04559135f},
        {0.42178576f, -0.75952837f, 0.49519030f, 0.32998807f},
        {0.00000000f, 0.00000000f, 0.00000000f, 1.00000000f}
    },
        .theta_ref = {0.30752389f, 0.34326391f, -0.98448155f, -0.67436843f, 0.15386043f, 0.10678277f},
        .converged = 1,
        .description = "ik_rng_seed0"
    },
    /* [2] ik_rng_seed1 */
    {
        .seed = {0.95806793f, 0.08528376f, 0.05336284f, 0.28415974f, 0.38678644f, 0.05305377f},
        .T_target = {
        {0.81915598f, -0.40462409f, 0.40652530f, 0.08423673f},
        {-0.52644765f, -0.24905556f, 0.81291094f, 0.14789864f},
        {-0.22767596f, -0.87991515f, -0.41702876f, 0.21222186f},
        {0.00000000f, 0.00000000f, 0.00000000f, 1.00000000f}
    },
        .theta_ref = {1.02779395f, 0.07672293f, -0.02442056f, 0.19262840f, 0.38552217f, 0.04126352f},
        .converged = 1,
        .description = "ik_rng_seed1"
    },
    /* [3] ik_rng_seed2 */
    {
        .seed = {-0.30923254f, -0.05065903f, 0.60379577f, 0.47558221f, -0.45490594f, -0.06971549f},
        .T_target = {
        {-0.47949281f, -0.03402854f, 0.87688580f, 0.13175909f},
        {-0.85244596f, 0.25534138f, -0.45621997f, -0.05385161f},
        {-0.20838073f, -0.96625195f, -0.15144185f, 0.17699267f},
        {0.00000000f, 0.00000000f, 0.00000000f, 1.00000000f}
    },
        .theta_ref = {-0.32193362f, -0.11802173f, 0.66132588f, 0.39272870f, -0.41798175f, -0.12542138f},
        .converged = 1,
        .description = "ik_rng_seed2"
    },
    /* [4] ik_rng_seed3 */
    {
        .seed = {0.61205563f, -0.33821098f, -0.82115034f, -0.48659471f, -0.44576728f, 0.68241732f},
        .T_target = {
        {0.72627547f, 0.68399490f, -0.06837336f, -0.00073393f},
        {-0.66274419f, 0.72315159f, 0.19447860f, 0.01373050f},
        {0.18246667f, -0.09593099f, 0.97852090f, 0.39337024f},
        {0.00000000f, 0.00000000f, 0.00000000f, 1.00000000f}
    },
        .theta_ref = {0.58832443f, -0.32608311f, -0.86404920f, -0.56344666f, -0.38324108f, 0.75852568f},
        .converged = 1,
        .description = "ik_rng_seed3"
    },
    /* [5] ik_rng_seed4 */
    {
        .seed = {-0.01192195f, 0.60782628f, 0.34257765f, -0.52390555f, -1.03990823f, -0.71430035f},
        .T_target = {
        {0.27474890f, 0.45730453f, 0.84580471f, 0.18164479f},
        {-0.49506628f, -0.68681573f, 0.53215932f, 0.04177548f},
        {0.82427084f, -0.56493958f, 0.03769418f, 0.13770780f},
        {0.00000000f, 0.00000000f, 0.00000000f, 1.00000000f}
    },
        .theta_ref = {0.07631241f, 0.65339695f, 0.24838666f, -0.57661638f, -1.02552991f, -0.62476328f},
        .converged = 1,
        .description = "ik_rng_seed4"
    },
    /* [6] ik_rng_seed5 */
    {
        .seed = {0.84741998f, -0.65071566f, 0.65366613f, -0.55494266f, -0.09045559f, -0.74245826f},
        .T_target = {
        {0.11586153f, 0.80957680f, 0.57546634f, 0.07007218f},
        {-0.11626214f, -0.56433194f, 0.81732036f, 0.08959333f},
        {0.98643764f, -0.16160094f, 0.02873877f, 0.21676294f},
        {0.00000000f, 0.00000000f, 0.00000000f, 1.00000000f}
    },
        .theta_ref = {0.85488916f, -0.56953343f, 0.67666680f, -0.64848884f, -0.16994046f, -0.76396494f},
        .converged = 1,
        .description = "ik_rng_seed5"
    },
    /* [7] ik_rng_seed6 */
    {
        .seed = {0.82780139f, -0.16156097f, 1.06656581f, -0.29922318f, 0.87755386f, -0.73275743f},
        .T_target = {
        {0.95344428f, 0.24999400f, 0.16866242f, 0.05000178f},
        {0.28226253f, -0.93668092f, -0.20726004f, 0.02523847f},
        {0.10616910f, 0.24521798f, -0.96363700f, 0.10263828f},
        {0.00000000f, 0.00000000f, 0.00000000f, 1.00000000f}
    },
        .theta_ref = {0.75819489f, -0.23363428f, 1.04108689f, -0.37321259f, 0.81972995f, -0.82312380f},
        .converged = 1,
        .description = "ik_rng_seed6"
    },
    /* [8] ik_rng_seed7 */
    {
        .seed = {-0.40024175f, -0.05363950f, 0.83651346f, 0.25775334f, 0.64977969f, -0.02566548f},
        .T_target = {
        {-0.51027531f, -0.84501023f, 0.15992754f, 0.07950668f},
        {-0.85355229f, 0.52035727f, 0.02601526f, -0.03384304f},
        {-0.10520262f, -0.12323157f, -0.98678589f, 0.10544857f},
        {0.00000000f, 0.00000000f, 0.00000000f, 1.00000000f}
    },
        .theta_ref = {-0.46859843f, -0.01084695f, 0.80399034f, 0.15801601f, 0.65176202f, -0.04290605f},
        .converged = 1,
        .description = "ik_rng_seed7"
    },
    /* [9] ik_rng_seed8 */
    {
        .seed = {1.02111209f, 0.47019244f, -0.65809569f, 0.02967728f, 0.91321972f, 0.68954406f},
        .T_target = {
        {0.44310475f, -0.80519979f, 0.39409576f, 0.10559854f},
        {-0.72435985f, -0.06258158f, 0.68657581f, 0.15610779f},
        {-0.52816757f, -0.58969215f, -0.61098460f, 0.22389289f},
        {0.00000000f, 0.00000000f, 0.00000000f, 1.00000000f}
    },
        .theta_ref = {0.95130998f, 0.38101280f, -0.61232689f, 0.10001364f, 0.89338368f, 0.60734012f},
        .converged = 1,
        .description = "ik_rng_seed8"
    },
    /* [10] ik_rng_seed9 */
    {
        .seed = {-0.39844832f, 0.21756985f, 0.31273996f, -1.05518710f, -0.68765302f, 0.59345694f},
        .T_target = {
        {0.19652364f, -0.03012282f, 0.98003626f, 0.15838388f},
        {-0.93382181f, -0.31047500f, 0.17771351f, -0.03799884f},
        {0.29892353f, -0.95010415f, -0.08914502f, 0.17667204f},
        {0.00000000f, 0.00000000f, 0.00000000f, 1.00000000f}
    },
        .theta_ref = {-0.45021081f, 0.17557228f, 0.39069492f, -1.02442873f, -0.75652736f, 0.50468263f},
        .converged = 1,
        .description = "ik_rng_seed9"
    },
    /* [11] ik_rng_seed10 */
    {
        .seed = {0.44701052f, 0.37708991f, -0.11614067f, 0.26933382f, -1.05391102f, 0.22619070f},
        .T_target = {
        {0.46841020f, 0.53216453f, 0.70526080f, 0.17134079f},
        {-0.82036278f, 0.55833553f, 0.12355703f, 0.07206292f},
        {-0.32801950f, -0.63644508f, 0.69809803f, 0.25553386f},
        {0.00000000f, 0.00000000f, 0.00000000f, 1.00000000f}
    },
        .theta_ref = {0.46470281f, 0.38482376f, -0.17808512f, 0.24453212f, -1.01462119f, 0.13859562f},
        .converged = 1,
        .description = "ik_rng_seed10"
    },
    /* [12] ik_rng_seed11 */
    {
        .seed = {-0.02569383f, -0.24344596f, -0.68681761f, 0.32597841f, -0.33192638f, 0.96852868f},
        .T_target = {
        {0.86553209f, 0.37614939f, 0.33070506f, 0.06031650f},
        {-0.34776019f, 0.92651199f, -0.14366066f, -0.01320048f},
        {-0.36044007f, 0.00933685f, 0.93273564f, 0.37628306f},
        {0.00000000f, 0.00000000f, 0.00000000f, 1.00000000f}
    },
        .theta_ref = {-0.11157798f, -0.25632626f, -0.60796632f, 0.29927498f, -0.36753878f, 1.03711077f},
        .converged = 1,
        .description = "ik_rng_seed11"
    }
};

#endif /* IK_TEST_VECTORS_H */
```

## src/hal_flash_stub.c
```c
/*
 * OctroBot - HAL Flash Stub for Unit Tests
 * SPDX-License-Identifier: Apache-2.0
 *
 * Provides stub implementations of hal_flash functions so that
 * robot_geometry.c can link on native_posix without NVS.
 * All reads return errors, forcing robot_geometry_load_from_flash()
 * to fall back to factory defaults.
 */

#include "hal_flash.h"

int hal_flash_init(void)
{
	return HAL_OK;
}

int hal_flash_write(const char *key, const void *data, size_t len)
{
	(void)key;
	(void)data;
	(void)len;
	return HAL_ERROR;
}

int hal_flash_read(const char *key, void *data, size_t len)
{
	(void)key;
	(void)data;
	(void)len;
	return HAL_ERROR;  /* Forces factory defaults fallback */
}

int hal_flash_delete(const char *key)
{
	(void)key;
	return HAL_ERROR;
}

bool hal_flash_exists(const char *key)
{
	(void)key;
	return false;
}
```

## src/test_cartesian_pose.c
```c
/*
 * OctroBot - cartesian_pose_to_joints (pure pose->joints core) tests
 * SPDX-License-Identifier: Apache-2.0
 *
 * Round-trip: pick known joint angles -> FK -> pose (position + ZYX RPY) ->
 * cartesian_pose_to_joints -> out_theta -> FK(out_theta) must match the pose.
 */

#include <zephyr/ztest.h>
#include "kinematics_math.h"
#include "robot_geometry.h"
#include "forward_kinematics_poe.h"
#include "cartesian_pose.h"
#include <math.h>

/* IK converges to eomg=1e-3 rad / ev=1e-4 m; float32 FK round-trip adds
 * rounding. 5e-3 leaves margin on the recovered pose. */
#define CP_POSE_TOL 5e-3f

struct cartesian_pose_fixture {
	poe_robot_model_t model;
};

static void *cp_setup(void)
{
	static struct cartesian_pose_fixture fixture;
	fixture.model = robot_geometry_factory_defaults();
	return &fixture;
}

/* Extract ZYX intrinsic roll/pitch/yaw (radians) from a rotation matrix. */
static void rpy_from_mat3(const mat3x3_t *R, float *roll, float *pitch,
			  float *yaw)
{
	*yaw = atan2f(R->m[1][0], R->m[0][0]);
	*pitch = atan2f(-R->m[2][0],
			sqrtf(R->m[2][1] * R->m[2][1] + R->m[2][2] * R->m[2][2]));
	*roll = atan2f(R->m[2][1], R->m[2][2]);
}

ZTEST_F(cartesian_pose, test_round_trip)
{
	const float theta_true[NUM_JOINTS] = {
		0.2f, -0.3f, 0.4f, -0.2f, 0.3f, -0.1f
	};
	mat4x4_t T_true;
	zassert_true(forward_kinematics_compute(&fixture->model, theta_true,
						&T_true), "FK setup");

	vec3_t p = mat4x4_get_translation(&T_true);
	mat3x3_t R = mat4x4_get_rotation(&T_true);
	float roll, pitch, yaw;
	rpy_from_mat3(&R, &roll, &pitch, &yaw);

	const float seed[NUM_JOINTS] = {
		0.1f, -0.2f, 0.3f, -0.1f, 0.2f, 0.0f
	};
	float out[NUM_JOINTS] = {0};
	cmove_status_t st = cartesian_pose_to_joints(
		&fixture->model, p.x, p.y, p.z,
		rad_to_deg(roll), rad_to_deg(pitch), rad_to_deg(yaw),
		seed, out, NULL);
	zassert_equal(st, CMOVE_OK, "expected CMOVE_OK, got %d", st);

	mat4x4_t T_check;
	zassert_true(forward_kinematics_compute(&fixture->model, out, &T_check),
		     "FK recheck");
	zassert_true(mat4x4_is_equal(&T_check, &T_true, CP_POSE_TOL),
		     "FK(pose_to_joints(pose)) should match pose");
}

ZTEST_F(cartesian_pose, test_null_args)
{
	const float seed[NUM_JOINTS] = {0};
	float out[NUM_JOINTS] = {0};
	zassert_equal(cartesian_pose_to_joints(NULL, 0, 0, 0, 0, 0, 0, seed, out,
					       NULL),
		      CMOVE_BAD_ARGS, "NULL model");
	zassert_equal(cartesian_pose_to_joints(&fixture->model, 0, 0, 0, 0, 0, 0,
					       NULL, out, NULL),
		      CMOVE_BAD_ARGS, "NULL seed");
	zassert_equal(cartesian_pose_to_joints(&fixture->model, 0, 0, 0, 0, 0, 0,
					       seed, NULL, NULL),
		      CMOVE_BAD_ARGS, "NULL out");
}

ZTEST_F(cartesian_pose, test_unreachable)
{
	const float seed[NUM_JOINTS] = {0};
	float out[NUM_JOINTS] = {0};
	/* 5 m away is far outside the ~0.3 m workspace. */
	cmove_status_t st = cartesian_pose_to_joints(
		&fixture->model, 5.0f, 5.0f, 5.0f, 0, 0, 0, seed, out, NULL);
	zassert_equal(st, CMOVE_NO_SOLUTION,
		      "unreachable pose should be CMOVE_NO_SOLUTION, got %d", st);
}

ZTEST_F(cartesian_pose, test_out_of_limits)
{
	/* Tighten joint limits to +/-150 deg for this test. wrap_to_pi caps IK
	 * output at +/-180 deg, so the OUT_OF_LIMITS path is only reachable with a
	 * limit below 180; pin it here instead of relying on the factory default. */
	for (int i = 0; i < NUM_JOINTS; i++) {
		fixture->model.joint_limits_min[i] = deg_to_rad(-150.0f);
		fixture->model.joint_limits_max[i] = deg_to_rad(150.0f);
	}

	/* Joint 0 at 2.80 rad (160 deg) is beyond the +2.618 rad (150 deg) limit.
	 * Build the pose from this config, then seed IK right next to it so the
	 * solver converges back to the out-of-limits solution. */
	const float theta_oob[NUM_JOINTS] = {
		2.80f, 0.10f, 0.10f, 0.00f, 0.10f, 0.00f
	};
	mat4x4_t T;
	zassert_true(forward_kinematics_compute(&fixture->model, theta_oob, &T),
		     "FK setup");

	vec3_t p = mat4x4_get_translation(&T);
	mat3x3_t R = mat4x4_get_rotation(&T);
	float roll, pitch, yaw;
	rpy_from_mat3(&R, &roll, &pitch, &yaw);

	/* Seed very close to the out-of-limits config. */
	const float seed[NUM_JOINTS] = {
		2.78f, 0.08f, 0.12f, 0.00f, 0.08f, 0.00f
	};
	float out[NUM_JOINTS] = {0};
	cmove_status_t st = cartesian_pose_to_joints(
		&fixture->model, p.x, p.y, p.z,
		rad_to_deg(roll), rad_to_deg(pitch), rad_to_deg(yaw),
		seed, out, NULL);
	zassert_equal(st, CMOVE_OUT_OF_LIMITS,
		      "expected CMOVE_OUT_OF_LIMITS, got %d", st);
}

ZTEST_SUITE(cartesian_pose, NULL, cp_setup, NULL, NULL, NULL);
```

## src/test_fk_ground_truth.c
```c
/*
 * OctroBot - FK Ground-Truth Cross-Validation Tests
 * SPDX-License-Identifier: Apache-2.0
 *
 * Compares forward_kinematics_compute() against reference values produced by
 * the modern_robotics Python library (float64).  Test vectors are embedded via
 * the auto-generated header fk_test_vectors.h.
 *
 * Regenerate vectors:
 *   cd validation && python gen_test_vectors.py
 * Then rebuild native tests:
 *   make test-native
 *
 * Tolerance: 1e-4 — accounts for float32 vs float64 accumulated error over
 * 6 chained matrix exponentials.
 */

#include <zephyr/ztest.h>
#include "kinematics_math.h"
#include "robot_geometry.h"
#include "forward_kinematics_poe.h"
#include "fk_test_vectors.h"
#include <math.h>

#define FK_GT_TOL 1e-4f

/* ======================================================================== */
/* Fixture                                                                  */
/* ======================================================================== */

struct fk_ground_truth_fixture {
	poe_robot_model_t model;
};

static void *fk_gt_setup(void)
{
	static struct fk_ground_truth_fixture fixture;
	fixture.model = robot_geometry_factory_defaults();
	return &fixture;
}

/* ======================================================================== */
/* Tests                                                                    */
/* ======================================================================== */

ZTEST_F(fk_ground_truth, test_all_vectors)
{
	for (int v = 0; v < NUM_FK_TEST_VECTORS; v++) {
		const fk_test_vector_t *vec = &FK_TEST_VECTORS[v];
		mat4x4_t T;

		bool ok = forward_kinematics_compute(&fixture->model, vec->theta, &T);
		zassert_true(ok, "vector %d (%s): compute returned false",
			     v, vec->description);

		for (int r = 0; r < 4; r++) {
			for (int c = 0; c < 4; c++) {
				float got      = T.m[r][c];
				float expected = vec->T_expected[r][c];

				zassert_true(
					is_near_equal(got, expected, FK_GT_TOL),
					"vector %d (%s) T[%d][%d]: "
					"got %.6f expected %.6f delta %.2e",
					v, vec->description, r, c,
					(double)got, (double)expected,
					(double)fabsf(got - expected));
			}
		}
	}
}

ZTEST_F(fk_ground_truth, test_zero_config_equals_M)
{
	/* Explicit check: FK(zero) == M, matching vector index 0 */
	const fk_test_vector_t *vec = &FK_TEST_VECTORS[0];
	float theta[NUM_JOINTS] = {0};
	mat4x4_t T;

	zassert_true(forward_kinematics_compute(&fixture->model, theta, &T));
	zassert_true(mat4x4_is_equal(&T, &fixture->model.M, FK_GT_TOL),
		     "FK at zero config should equal home config M");

	/* Also verify our embedded M matches the C factory default */
	for (int r = 0; r < 4; r++) {
		for (int c = 0; c < 4; c++) {
			zassert_true(
				is_near_equal(fixture->model.M.m[r][c],
					      vec->T_expected[r][c], FK_GT_TOL),
				"C factory M[%d][%d]=%.6f != YAML M[%d][%d]=%.6f — "
				"robot_geometry.c and robot_config.yaml are out of sync",
				r, c, (double)fixture->model.M.m[r][c],
				r, c, (double)vec->T_expected[r][c]);
		}
	}
}

/* ======================================================================== */
/* Suite registration                                                       */
/* ======================================================================== */

ZTEST_SUITE(fk_ground_truth, NULL, fk_gt_setup, NULL, NULL, NULL);
```

## src/test_forward_kinematics.c
```c
/*
 * OctroBot - Forward Kinematics Unit Tests
 * SPDX-License-Identifier: Apache-2.0
 *
 * Tests: forward_kinematics_compute, _compute_pose, _partial.
 * Uses factory default geometry from robot_geometry_factory_defaults().
 */

#include <zephyr/ztest.h>
#include "kinematics_math.h"
#include "robot_geometry.h"
#include "forward_kinematics_poe.h"
#include <math.h>
#include <string.h>

#define FK_TOL 1e-4f

/* ======================================================================== */
/* Shared fixture: factory-default robot model                              */
/* ======================================================================== */

struct forward_kinematics_fixture {
	poe_robot_model_t model;
};

static void *fk_setup(void)
{
	static struct forward_kinematics_fixture fixture;
	fixture.model = robot_geometry_factory_defaults();
	return &fixture;
}

/* ======================================================================== */
/* Zero configuration tests                                                 */
/* ======================================================================== */

ZTEST_F(forward_kinematics, test_zero_config_equals_home)
{
	/* FK(0,0,0,0,0,0) must equal the home configuration M */
	float theta[NUM_JOINTS] = {0};
	mat4x4_t T;
	bool ok = forward_kinematics_compute(&fixture->model, theta, &T);

	zassert_true(ok, "FK compute should succeed");
	zassert_true(mat4x4_is_equal(&T, &fixture->model.M, FK_TOL),
		     "FK at zero config should equal M");
}

ZTEST_F(forward_kinematics, test_zero_config_position)
{
	/* Position at zero config equals the home config translation [0.168, 0, 0.243] */
	float theta[NUM_JOINTS] = {0};
	vec3_t pos;
	mat3x3_t orient;
	bool ok = forward_kinematics_compute_pose(&fixture->model, theta,
						   &pos, &orient);

	zassert_true(ok);
	zassert_true(is_near_equal(pos.x, 0.168f, FK_TOL));
	zassert_true(is_near_equal(pos.y, 0.0f, FK_TOL));
	zassert_true(is_near_equal(pos.z, 0.243f, FK_TOL));
}

/* ======================================================================== */
/* Single-joint rotation tests                                              */
/* ======================================================================== */

ZTEST_F(forward_kinematics, test_base_rotation_90deg)
{
	/* Joint 0: Z-rotation by π/2.
	 * Home translation [0.168, 0, 0.243] → expected [0, 0.168, 0.243].
	 * (Rz(π/2) maps x→y in translation; z unchanged for pure base rotation)
	 */
	float theta[NUM_JOINTS] = {0};
	theta[0] = (float)(M_PI / 2.0);

	vec3_t pos;
	mat3x3_t orient;
	bool ok = forward_kinematics_compute_pose(&fixture->model, theta,
						   &pos, &orient);

	zassert_true(ok);
	zassert_true(is_near_equal(pos.x, 0.0f, FK_TOL),
		     "x should be ~0 after 90 deg Z rotation");
	zassert_true(is_near_equal(pos.y, 0.168f, FK_TOL),
		     "y should be ~0.168 after 90 deg Z rotation");
	zassert_true(is_near_equal(pos.z, 0.243f, FK_TOL),
		     "z should be unchanged");
}

ZTEST_F(forward_kinematics, test_base_rotation_180deg)
{
	/* Joint 0: Z-rotation by π → position [0.168, 0, 0.243] → [-0.168, 0, 0.243] */
	float theta[NUM_JOINTS] = {0};
	theta[0] = (float)M_PI;

	vec3_t pos;
	mat3x3_t orient;
	bool ok = forward_kinematics_compute_pose(&fixture->model, theta,
						   &pos, &orient);

	zassert_true(ok);
	zassert_true(is_near_equal(pos.x, -0.168f, FK_TOL));
	zassert_true(is_near_equal(pos.y, 0.0f, FK_TOL));
	zassert_true(is_near_equal(pos.z, 0.243f, FK_TOL));
}

/* ======================================================================== */
/* Partial chain tests                                                      */
/* ======================================================================== */

ZTEST_F(forward_kinematics, test_partial_chain_joint0_only)
{
	/* Partial FK up to joint 0 with zero angles should equal M */
	float theta[NUM_JOINTS] = {0};
	mat4x4_t T;
	bool ok = forward_kinematics_partial(&fixture->model, theta, 0, &T);

	zassert_true(ok, "Partial FK should succeed");
	/* exp([ξ₀]·0) · M = I · M = M */
	zassert_true(mat4x4_is_equal(&T, &fixture->model.M, FK_TOL));
}

ZTEST_F(forward_kinematics, test_partial_chain_differs)
{
	/* Partial chain to joint 2 vs full chain should generally differ
	 * when joints 3-5 are non-zero
	 */
	float theta[NUM_JOINTS] = {0};
	theta[3] = deg_to_rad(30.0f);

	mat4x4_t T_partial, T_full;
	forward_kinematics_partial(&fixture->model, theta, 2, &T_partial);
	forward_kinematics_compute(&fixture->model, theta, &T_full);

	/* Partial chain ignores joints 3-5, full chain doesn't */
	zassert_false(mat4x4_is_equal(&T_partial, &T_full, FK_TOL),
		      "Partial and full should differ when later joints nonzero");
}

/* ======================================================================== */
/* Null/invalid input tests                                                 */
/* ======================================================================== */

ZTEST(forward_kinematics, test_null_model_returns_false)
{
	float theta[NUM_JOINTS] = {0};
	mat4x4_t T;
	bool ok = forward_kinematics_compute(NULL, theta, &T);
	zassert_false(ok);
}

ZTEST(forward_kinematics, test_null_angles_returns_false)
{
	poe_robot_model_t model = robot_geometry_factory_defaults();
	mat4x4_t T;
	bool ok = forward_kinematics_compute(&model, NULL, &T);
	zassert_false(ok);
}

ZTEST(forward_kinematics, test_null_output_returns_false)
{
	poe_robot_model_t model = robot_geometry_factory_defaults();
	float theta[NUM_JOINTS] = {0};
	bool ok = forward_kinematics_compute(&model, theta, NULL);
	zassert_false(ok);
}

/* ======================================================================== */
/* Consistency tests                                                        */
/* ======================================================================== */

ZTEST_F(forward_kinematics, test_deterministic_output)
{
	/* Same input → identical output, every time */
	float theta[NUM_JOINTS] = {0.1f, -0.2f, 0.3f, -0.4f, 0.5f, -0.6f};
	mat4x4_t T1, T2;

	forward_kinematics_compute(&fixture->model, theta, &T1);
	forward_kinematics_compute(&fixture->model, theta, &T2);

	zassert_true(mat4x4_is_equal(&T1, &T2, 1e-6f),
		     "FK must be deterministic");
}

ZTEST_F(forward_kinematics, test_compute_pose_matches_full)
{
	/* forward_kinematics_compute_pose should extract same position/orientation
	 * as manually extracting from forward_kinematics_compute result
	 */
	float theta[NUM_JOINTS] = {0.3f, -0.1f, 0.5f, 0.0f, -0.2f, 0.4f};
	mat4x4_t T;
	vec3_t pos;
	mat3x3_t orient;

	forward_kinematics_compute(&fixture->model, theta, &T);
	forward_kinematics_compute_pose(&fixture->model, theta, &pos, &orient);

	/* Compare position */
	vec3_t t_from_T = mat4x4_get_translation(&T);
	zassert_true(is_near_equal(pos.x, t_from_T.x, FK_TOL));
	zassert_true(is_near_equal(pos.y, t_from_T.y, FK_TOL));
	zassert_true(is_near_equal(pos.z, t_from_T.z, FK_TOL));

	/* Compare orientation */
	mat3x3_t R_from_T = mat4x4_get_rotation(&T);
	zassert_true(mat3x3_is_equal(&orient, &R_from_T, FK_TOL));
}

ZTEST_F(forward_kinematics, test_fk_output_is_valid_se3)
{
	/* FK output must always be a valid SE(3) transform */
	float theta[NUM_JOINTS] = {1.0f, -0.5f, 0.7f, -1.2f, 0.3f, 0.8f};
	mat4x4_t T;
	forward_kinematics_compute(&fixture->model, theta, &T);

	/* Bottom row = [0, 0, 0, 1] */
	zassert_true(is_near_equal(T.m[3][0], 0.0f, 1e-6f));
	zassert_true(is_near_equal(T.m[3][1], 0.0f, 1e-6f));
	zassert_true(is_near_equal(T.m[3][2], 0.0f, 1e-6f));
	zassert_true(is_near_equal(T.m[3][3], 1.0f, 1e-6f));

	/* R^T R = I (orthogonal rotation) */
	mat3x3_t R = mat4x4_get_rotation(&T);
	mat3x3_t Rt = mat3x3_transpose(&R);
	mat3x3_t product = mat3x3_mul(&Rt, &R);
	mat3x3_t I = mat3x3_identity();
	zassert_true(mat3x3_is_equal(&product, &I, FK_TOL),
		     "R^T R should equal I");
}

/* ======================================================================== */
/* Test suite registration                                                  */
/* ======================================================================== */

ZTEST_SUITE(forward_kinematics, NULL, fk_setup, NULL, NULL, NULL);
```

## src/test_ik_ground_truth.c
```c
/*
 * OctroBot - IK Ground-Truth Cross-Validation Tests
 * SPDX-License-Identifier: Apache-2.0
 *
 * Each vector holds a seed, a target pose T_target produced by FK on a known
 * config, and whether modern_robotics.IKinBody converged from that seed.
 * For every vector where the reference converged, the C solver must converge
 * too and FK(out) must match T_target (poses, since IK solutions are not
 * unique).
 *
 * Note: theta_ref in each vector is the modern_robotics IKinBody reference
 * solution, retained in the header for human inspection and the Python
 * cross-validator.  It is intentionally NOT compared here because IK
 * solutions are non-unique; the pose round-trip FK(IK(T)) == T is the
 * correctness criterion.
 *
 * Regenerate vectors:
 *   cd validation && python gen_test_vectors.py
 * Then: make test-native
 */

#include <zephyr/ztest.h>
#include "kinematics_math.h"
#include "robot_geometry.h"
#include "forward_kinematics_poe.h"
#include "inverse_kinematics_poe.h"
#include "ik_test_vectors.h"
#include <math.h>

/* Solver converges to eomg=1e-3, ev=1e-4; float32 FK round-trip adds rounding. 5e-3 leaves margin. */
#define IK_GT_POSE_TOL 5e-3f

/* ======================================================================== */
/* Fixture                                                                  */
/* ======================================================================== */

struct ik_ground_truth_fixture {
	poe_robot_model_t model;
};

static void *ik_gt_setup(void)
{
	static struct ik_ground_truth_fixture fixture;
	fixture.model = robot_geometry_factory_defaults();
	return &fixture;
}

/* ======================================================================== */
/* Tests                                                                    */
/* ======================================================================== */

ZTEST_F(ik_ground_truth, test_all_vectors)
{
	for (int v = 0; v < NUM_IK_TEST_VECTORS; v++) {
		const ik_test_vector_t *vec = &IK_TEST_VECTORS[v];

		if (!vec->converged) {
			continue; /* reference did not converge; skip */
		}

		mat4x4_t T_target;
		for (int r = 0; r < 4; r++) {
			for (int c = 0; c < 4; c++) {
				T_target.m[r][c] = vec->T_target[r][c];
			}
		}

		float out[NUM_JOINTS] = {0};
		ik_status_t st = inverse_kinematics_compute(
			&fixture->model, &T_target, vec->seed, out, NULL, NULL);

		zassert_true(st == IK_SUCCESS || st == IK_OUT_OF_LIMITS,
			     "vector %d (%s): expected convergence, got %d",
			     v, vec->description, st);

		mat4x4_t T_check;
		zassert_true(forward_kinematics_compute(&fixture->model, out,
							&T_check),
			     "vector %d (%s): FK recheck failed",
			     v, vec->description);
		zassert_true(mat4x4_is_equal(&T_check, &T_target, IK_GT_POSE_TOL),
			     "vector %d (%s): FK(IK(T)) != T within %.0e",
			     v, vec->description, (double)IK_GT_POSE_TOL);
	}
}

/* ======================================================================== */
/* Suite registration                                                       */
/* ======================================================================== */

ZTEST_SUITE(ik_ground_truth, NULL, ik_gt_setup, NULL, NULL, NULL);
```

## src/test_inverse_kinematics.c
```c
/*
 * OctroBot - Inverse Kinematics Unit Tests
 * SPDX-License-Identifier: Apache-2.0
 */

#include <zephyr/ztest.h>
#include "kinematics_math.h"
#include "robot_geometry.h"
#include "forward_kinematics_poe.h"
#include "inverse_kinematics_poe.h"
#include <math.h>

#define IK_POSE_TOL 5e-3f

struct inverse_kinematics_fixture {
	poe_robot_model_t model;
};

static void *ik_setup(void)
{
	static struct inverse_kinematics_fixture fixture;
	fixture.model = robot_geometry_factory_defaults();
	return &fixture;
}

/* Build a 4x4 transform from identity rotation + translation (test helper). */
static mat4x4_t make_pose_identity_rot(float x, float y, float z)
{
	mat4x4_t T = mat4x4_identity();
	vec3_t t = vec3_create(x, y, z);
	mat4x4_set_translation(&T, &t);
	return T;
}

ZTEST_F(inverse_kinematics, test_default_params)
{
	ARG_UNUSED(fixture);
	ik_params_t p = inverse_kinematics_default_params();
	zassert_true(is_near_equal(p.eomg, 1e-3f, 1e-9f), "eomg default");
	zassert_true(is_near_equal(p.ev, 1e-4f, 1e-9f), "ev default");
	zassert_equal(p.max_iters, 50, "max_iters default");
	zassert_true(is_near_equal(p.lambda, 0.01f, 1e-9f), "lambda default");
}

ZTEST_F(inverse_kinematics, test_null_inputs_rejected)
{
	float seed[NUM_JOINTS] = {0};
	float out[NUM_JOINTS] = {0};
	mat4x4_t T = make_pose_identity_rot(0.2f, 0.0f, 0.2f);

	zassert_equal(inverse_kinematics_compute(NULL, &T, seed, out, NULL, NULL),
		      IK_INVALID_INPUT, "NULL model");
	zassert_equal(inverse_kinematics_compute(&fixture->model, NULL, seed, out, NULL, NULL),
		      IK_INVALID_INPUT, "NULL target");
	zassert_equal(inverse_kinematics_compute(&fixture->model, &T, NULL, out, NULL, NULL),
		      IK_INVALID_INPUT, "NULL seed");
	zassert_equal(inverse_kinematics_compute(&fixture->model, &T, seed, NULL, NULL, NULL),
		      IK_INVALID_INPUT, "NULL out");
}

/* IK at the home pose with zero seed converges back to ~zero angles. */
ZTEST_F(inverse_kinematics, test_home_target_zero_seed)
{
	float seed[NUM_JOINTS] = {0};
	float out[NUM_JOINTS] = {0};
	int iters = -1;
	mat4x4_t T_target = robot_geometry_get_home_config(&fixture->model);

	ik_status_t st = inverse_kinematics_compute(&fixture->model, &T_target,
						    seed, out, NULL, &iters);

	zassert_equal(st, IK_SUCCESS, "home target should solve, got %d", st);
	for (int i = 0; i < NUM_JOINTS; i++) {
		zassert_true(fabsf(out[i]) < 1e-3f,
			     "joint %d should be ~0, got %.6f", i, (double)out[i]);
	}
	zassert_true(iters >= 0, "iters should be reported");
}

/* Round-trip: FK(theta) -> T, then IK(T, perturbed seed) -> theta', FK(theta') ~= T. */
ZTEST_F(inverse_kinematics, test_round_trip_pose_match)
{
	const float theta_true[NUM_JOINTS] = {
		0.2f, -0.3f, 0.4f, -0.2f, 0.3f, -0.1f
	};
	const float seed[NUM_JOINTS] = {
		0.1f, -0.2f, 0.3f, -0.1f, 0.2f, 0.0f
	};
	mat4x4_t T_target;
	zassert_true(forward_kinematics_compute(&fixture->model, theta_true,
						&T_target),
		     "FK setup should succeed");

	float out[NUM_JOINTS] = {0};
	ik_status_t st = inverse_kinematics_compute(&fixture->model, &T_target,
						    seed, out, NULL, NULL);
	zassert_true(st == IK_SUCCESS || st == IK_OUT_OF_LIMITS,
		     "IK should converge, got %d", st);

	mat4x4_t T_check;
	zassert_true(forward_kinematics_compute(&fixture->model, out, &T_check),
		     "FK recheck should succeed");
	zassert_true(mat4x4_is_equal(&T_check, &T_target, IK_POSE_TOL),
		     "FK(IK(T)) should match T within %.0e", (double)IK_POSE_TOL);
}

/* A target far outside the workspace cannot converge. */
ZTEST_F(inverse_kinematics, test_unreachable_target)
{
	float seed[NUM_JOINTS] = {0};
	float out[NUM_JOINTS] = {0};
	mat4x4_t T_target = make_pose_identity_rot(5.0f, 5.0f, 5.0f);

	ik_status_t st = inverse_kinematics_compute(&fixture->model, &T_target,
						    seed, out, NULL, NULL);
	zassert_equal(st, IK_NO_CONVERGENCE,
		      "far target should not converge, got %d", st);
}

ZTEST_SUITE(inverse_kinematics, NULL, ik_setup, NULL, NULL, NULL);
```
