/*
 * M5Stack Atom Lite Pin Control Configuration
 * Copyright (c) 2026 OctroBot Project
 *
 * SPDX-License-Identifier: Apache-2.0
 */

#include <zephyr/dt-bindings/pinctrl/esp-pinctrl-common.h>
#include <dt-bindings/pinctrl/esp32-pinctrl.h>
#include <zephyr/dt-bindings/pinctrl/esp32-gpio.h>

&pinctrl {
	uart1_default: uart1_default {
		group1 {
			pinmux = <UART1_TX_GPIO26>;
			output-high;
		};
		group2 {
			pinmux = <UART1_RX_GPIO32>;
			bias-pull-up;
		};
	};
};
